## config/boards/shields/onekey/Kconfig.defconfig
```kconfig
# Copyright (c) 2020 The ZMK Contributors
# SPDX-License-Identifier: MIT

config ZMK_USB
	default y

config BT
	default y

config ZMK_BLE
	default y

if SHIELD_ONEKEY

config ZMK_KEYBOARD_NAME
	default "The One Key"

endif
```
